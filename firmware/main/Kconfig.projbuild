## firmware/main/Kconfig.projbuild
```kconfig
menu "EdgeWake"

    menu "Wi-Fi and AWS IoT Core"
        config EW_WIFI_SSID
            string "Wi-Fi SSID"
            default ""
            help
                Leave empty to run fully offline (keyword spotting and GPIO
                actions keep working; telemetry and OTA are disabled).

        config EW_WIFI_PASSWORD
            string "Wi-Fi password"
            default ""

        config EW_AWS_IOT_ENDPOINT
            string "AWS IoT Core endpoint"
            default ""
            help
                Account-specific ATS endpoint, e.g.
                a1b2c3d4e5f6g7-ats.iot.ap-south-1.amazonaws.com
                (AWS console: IoT Core -> Settings -> Device data endpoint).

        config EW_THING_NAME
            string "AWS IoT thing name (also the MQTT client ID)"
            default "edgewake-01"

        config EW_HEALTH_PERIOD_S
            int "Health telemetry period (seconds)"
            range 5 3600
            default 30
    endmenu

    menu "Audio input (INMP441 I2S MEMS microphone)"
        config EW_I2S_BCLK_GPIO
            int "I2S bit clock (SCK) GPIO"
            default 5
        config EW_I2S_WS_GPIO
            int "I2S word select (WS) GPIO"
            default 6
        config EW_I2S_DIN_GPIO
            int "I2S data in (SD) GPIO"
            default 4
        config EW_MIC_SHIFT
            int "Right shift from the 32-bit I2S slot to int16"
            range 8 16
            default 14
            help
                The INMP441 sends 24-bit samples left-justified in a 32-bit
                slot. A shift of 16 keeps the top 16 bits (unity gain); every
                step below 16 adds 6 dB of digital gain (with saturation).
    endmenu

    menu "Keyword spotting"
        config EW_VAD_ENABLE
            bool "Gate inference with the energy VAD"
            default y
        config EW_INFER_EVERY_HOPS
            int "Run the CNN every N hops (1 hop = 20 ms)"
            range 1 10
            default 2
        config EW_SMOOTH_WINDOW
            int "Posterior smoothing window (inferences)"
            range 1 8
            default 3
        config EW_DETECT_THRESHOLD_PCT
            int "Detection threshold (percent, on smoothed probability)"
            range 50 99
            default 80
        config EW_REFRACTORY_MS
            int "Refractory period after a detection (ms)"
            range 0 5000
            default 1000
    endmenu

    menu "Actions and debug"
        config EW_LED_GPIO
            int "LED GPIO (keywords 'on' / 'off')"
            default 2
        config EW_AUX_GPIO
            int "Auxiliary output GPIO, e.g. a relay (keywords 'go' / 'stop')"
            default 1
        config EW_DEBUG_PROBES
            bool "Drive GPIO probe pins for logic-analyzer timing"
            default y
        config EW_PROBE_AUDIO_GPIO
            int "Probe: high while a DMA chunk is pushed into the ring"
            depends on EW_DEBUG_PROBES
            default 15
        config EW_PROBE_DSP_GPIO
            int "Probe: high while a hop is processed (VAD + MFCC + CNN)"
            depends on EW_DEBUG_PROBES
            default 16
        config EW_PROBE_INFER_GPIO
            int "Probe: high during TFLite Micro Invoke()"
            depends on EW_DEBUG_PROBES
            default 17
        config EW_PROBE_ACTION_GPIO
            int "Probe: pulses when a keyword action fires"
            depends on EW_DEBUG_PROBES
            default 18
        config EW_SELFTEST_FORCE_FAIL
            bool "Force the post-OTA self-test to fail (rollback demo)"
            default n
            help
                Build an image with this enabled, deliver it by OTA, and the
                device boots it once, fails the self-test, and rolls back to
                the previous image. Never enable in a release build.
    endmenu

endmenu
```
